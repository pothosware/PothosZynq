/*
 * CAUTION: This file is automatically generated by Xilinx.
 * Version:  
 * Today is: Tue Nov 18 16:16:50 2014
*/

/dts-v1/;
/include/ "ps.dtsi"
/include/ "pl.dtsi"
/{
	chosen {
		bootargs = "console=ttyPS0,115200 root=/dev/mmcblk0p2 rw earlyprintk rootfstype=ext4 rootwait";
		linux,stdout-path = &ps7_uart_1;
	} ;
	aliases {
		ethernet0 = &ps7_ethernet_0;
		serial0 = &ps7_uart_1;
		spi0 = &ps7_qspi_0;
	} ;
	ps7_ddr_0: memory@00100000 {
		device_type = "memory";
		reg = <0x0 0x40000000>;
	} ;
};
