/*
 * CAUTION: This file is automatically generated by Xilinx.
 * Version:  
 * Today is: Tue Dec 16 01:12:33 2014
*/

	&ps7_axi_interconnect_0 {
		ranges;
		axi_dma_0: axi-dma@40400000 {
			compatible = "pothos,xlnx,axi-dma";
			interrupt-parent = <&ps7_scugic_0>;
			interrupts = <0 29 4>, <0 30 4>;
			reg = <0x40400000 0x10000>;
			xlnx,include-sg ;
			xlnx,sg-include-stscntrl-strm ;
			dma-channel@40400000 {
				compatible = "xlnx,axi-dma-mm2s-channel";
				interrupts = <0 29 4>;
				xlnx,datawidth = <0x20>;
				xlnx,device-id = <0x0>;
			} ;
			dma-channel@40400030 {
				compatible = "xlnx,axi-dma-s2mm-channel";
				interrupts = <0 30 4>;
				xlnx,datawidth = <0x20>;
				xlnx,device-id = <0x0>;
			} ;
		} ;
	} ;
